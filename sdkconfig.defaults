## sdkconfig.defaults
```kconfig
CONFIG_ESP_WIFI_STATIC_RX_BUFFER_NUM=16
CONFIG_ESP_WIFI_DYNAMIC_RX_BUFFER_NUM=32
CONFIG_ESP_WIFI_DYNAMIC_TX_BUFFER_NUM=32
CONFIG_ESP_WIFI_AMPDU_TX_ENABLED=y
CONFIG_ESP_WIFI_TX_BA_WIN=32
CONFIG_ESP_WIFI_AMPDU_RX_ENABLED=y
CONFIG_ESP_WIFI_RX_BA_WIN=32

CONFIG_ESP_WIFI_IRAM_OPT=y
CONFIG_ESP_WIFI_SLP_IRAM_OPT=y
CONFIG_ESP_WIFI_RX_IRAM_OPT=y
CONFIG_ESP_WIFI_EXTRA_IRAM_OPT=y
CONFIG_ETH_IRAM_OPTIMIZATION=y

CONFIG_ETH_DMA_BUFFER_SIZE=1522
CONFIG_ETH_DMA_RX_BUFFER_NUM=30
CONFIG_ETH_DMA_TX_BUFFER_NUM=30

CONFIG_FREERTOS_IDLE_TASK_STACKSIZE=768

# Rust often needs a bit of an extra main task stack size compared to C (the default is 3K)
#CONFIG_ESP_MAIN_TASK_STACK_SIZE=8000

# Use this to set FreeRTOS kernel tick frequency to 1000 Hz (100 Hz by default).
# This allows to use 1 ms granuality for thread sleeps (10 ms by default).
#CONFIG_FREERTOS_HZ=1000

# Workaround for https://github.com/espressif/esp-idf/issues/7631
#CONFIG_MBEDTLS_CERTIFICATE_BUNDLE=n
#CONFIG_MBEDTLS_CERTIFICATE_BUNDLE_DEFAULT_FULL=n

# For minimum binary size
#CONFIG_BOOTLOADER_LOG_LEVEL_NONE=y
#CONFIG_BOOTLOADER_LOG_LEVEL=0

#CONFIG_LOG_DEFAULT_LEVEL_NONE=y
#CONFIG_LOG_DEFAULT_LEVEL=0
#CONFIG_LOG_MAXIMUM_EQUALS_DEFAULT=y
#CONFIG_LOG_MAXIMUM_LEVEL=0

#CONFIG_COMPILER_OPTIMIZATION_ASSERTIONS_DISABLE=y
#CONFIG_COMPILER_OPTIMIZATION_ASSERTION_LEVEL=0
#CONFIG_COMPILER_OPTIMIZATION_CHECKS_SILENT=y

#CONFIG_ESP_SYSTEM_PANIC_SILENT_REBOOT=y
```
